;電子サイコロ10F322版
;マトリックスでピン数を節約、ブザー出力は削除
;マトリックスのスキャンを3ステップ(中央と、左中・右中は同時に点かない)に

	PROCESSOR	PIC10F322
	INCLUDE	"P10F322.INC"

	RADIX	DEC

; CONFIG
; __config 0x24A0
 __CONFIG _FOSC_INTOSC & _BOREN_OFF & _WDTE_OFF & _PWRTE_OFF & _MCLRE_OFF & _CP_OFF & _LVP_OFF & _LPBOR_OFF & _BORV_LO & _WRT_OFF
#DEFINE	CAN_RESTART


;RA0
;RA1
;RA2
;RA3:ＳＷ

	UDATA
D_CNT1	RES	1
D_CNT2	RES	1
L_CNT1	RES	1
L_CNT2	RES	1
LED_CNT	RES	1
LED_CNT_ISR	RES	1
LED_BUFF	RES	1
SLEEP_CNTL	RES	1
SLEEP_CNTH	RES	1
STEP	RES	1
W_TEMP	RES	1
STATUS_TEMP	RES	1

	ORG	0
	CALL	PIC_INIT
	GOTO	START
	ORG	4
;	GOTO	INTER
INTER
	MOVWF	W_TEMP
	SWAPF	STATUS,W
	MOVWF	STATUS_TEMP

	BCF	INTCON,TMR0IF
;STEP >= 3なら STEP -= 3
	INCF	STEP,F
	MOVLW	3
	SUBWF	STEP,W
	BTFSC	STATUS,C
	MOVWF	STEP

;LED_CNT == 0 && STEP == 0ならSTEP = 3
	MOVF	STEP,W
	IORWF	LED_CNT_ISR,W
	BTFSS	STATUS,Z
	GOTO	$+3
	MOVLW	3
	MOVWF	STEP

	MOVF	STEP,W
	CALL	SHIFT_TABLE
	ANDWF	LED_BUFF,W
	BTFSC	STATUS,Z
	GOTO	LED_OFF

	CLRF	LATA		;切換の瞬間意図しないLEDが光るので一旦OFFに
	BCF	STATUS,C
	RLF	STEP,W
	CALL	TRIS_LAT_TABLE
	MOVWF	TRISA
	BSF	STATUS,C
	RLF	STEP,W
	CALL	TRIS_LAT_TABLE
	MOVWF	LATA

	GOTO	INTER_EXIT
LED_OFF
	MOVLW	B'1111'
	MOVWF	TRISA
	CLRF	LATA

INTER_EXIT
	SWAPF	STATUS_TEMP,W
	MOVWF	STATUS
	SWAPF	W_TEMP,F
	SWAPF	W_TEMP,W
	RETFIE

;さいころの値とLED出力の関係
;
TOP_OF_TABLE
	ADDWF	PCL,F
	RETLW	B'1110'	;6
	RETLW	B'0001'	;1
	RETLW	B'0010'	;2
	RETLW	B'0101'	;3
	RETLW	B'0110'	;4
	RETLW	B'0111'	;5

;1 << W
SHIFT_TABLE
	ADDWF	PCL,F
	DT	0x01,0x02,0x04,0x08

;ピン番号：ポート対応
#DEFINE	PIN0	0x01
#DEFINE	PIN1	0x02
#DEFINE	PIN2	0x04

;LED出力、ピン番号の関係
;(マトリックス)
TRIS_LAT_TABLE
	ADDWF	PCL,F
;LED中央1（1,3,5）
	RETLW	~PIN0 & ~PIN1	;出力にするピン
	RETLW	PIN0			;Hiにするピン
;LED左上2、右下3（2,4,5,6）
	RETLW	~PIN0 & ~PIN2
	RETLW	PIN0
;LED左下6、右上7（3,4,5,6）
	RETLW	~PIN0 & ~PIN1
	RETLW	PIN1
;LED左中4、右中5（6）
	RETLW	~PIN1 & ~PIN2
	RETLW	PIN1

PIC_INIT
	MOVLW	0x50	;内蔵クロック4MHzを使用
	MOVWF	OSCCON

	CLRF	LATA
	CLRF	ANSELA
;入出力設定
	MOVLW	B'1111'
	MOVWF	TRISA
;プルアップ有効ピン設定
	MOVLW	B'1000'
	MOVWF	WPUA

	MOVLW	0x01
	CLRF	OPTION_REG

	BSF	IOCAN,3

	MOVLW	7
	MOVWF	SLEEP_CNTH
	CLRF	SLEEP_CNTL
	CLRF	STEP
	CLRF	LED_BUFF
	CLRF	TMR0
	BSF	INTCON,TMR0IE
	RETFIE

START
	CALL	POWR_SAVE
MAIN
	MOVF	TMR0,W
	MOVWF	LED_CNT
	BTFSC	PORTA,3
	GOTO	START
LOOP1
	MOVLW	.1
	MOVWF	L_CNT1
	MOVWF	L_CNT2
LOOP2
	MOVLW	.5	;回転の速さ
	CALL	DELAY_MS
#IFDEF	CAN_RESTART
	DECFSZ	L_CNT1,F
	GOTO	LOOP2
	CALL	INC_LED
	BTFSS	PORTA,3
	GOTO	LOOP1
#ELSE
	DECFSZ	L_CNT1,F
	GOTO	LOOP2
	CALL	INC_LED
#ENDIF
	MOVF	L_CNT2,W
	MOVWF	L_CNT1
	INCF	L_CNT2,F
	MOVF	L_CNT2,W
	XORLW	.50	;x回転の速さで停止
	BTFSS	STATUS,Z
	GOTO	LOOP2

	GOTO	MAIN
INC_LED
	INCF	LED_CNT,F
	MOVLW	6
	SUBWF	LED_CNT,W
	BTFSS	STATUS,C
	GOTO	$+3
	MOVWF	LED_CNT
	GOTO	$-5

	MOVF	LED_CNT,W
	MOVWF	LED_CNT_ISR
	CALL	TOP_OF_TABLE
	MOVWF	LED_BUFF

	RLF	L_CNT2,W
BEEP
	MOVWF	D_CNT2

	NOP;BCF	LATA,5
	CALL	BEEP_DELAY
	NOP;BSF	LATA,5
	CALL	BEEP_DELAY
	DECFSZ	D_CNT2,F
	GOTO	$-5
	RETURN

;ビープ音用delay(未使用、互換性のため待ち時間のみ処理)
BEEP_DELAY
	MOVLW	.124	;音の周期(大きいほど低い音)
	MOVWF	D_CNT1
	NOP
	DECFSZ	D_CNT1,F
	GOTO	$ - 2
DELAY_4US
	RETURN

DELAY_MS
	MOVWF	D_CNT2
	MOVLW	.249
	MOVWF	D_CNT1
	NOP
	DECFSZ	D_CNT1,F
	GOTO	$ - 2
	DECFSZ	D_CNT2,F
	GOTO	$ - 6
	RETURN

POWR_SAVE
	MOVLW	.16
	CALL	DELAY_MS
	DECFSZ	SLEEP_CNTL,F
	RETURN
	DECFSZ	SLEEP_CNTH,F
	RETURN
	MOVLW	7
	MOVWF	SLEEP_CNTH

	MOVLW	B'111'
	MOVWF	TRISA
	MOVWF	LATA
	MOVLW	0x08
	MOVWF	INTCON
	MOVF	LATA,W
	CLRF	IOCAF
	SLEEP
	NOP
	CLRF	IOCAF
	MOVLW	0x20
	MOVWF	INTCON
	RETFIE


	END